## src/application/samples/products/air_mouse/Kconfig
```kconfig
#===============================================================================
# @brief    Kconfig file.
# Copyright (c) HiSilicon (Shanghai) Technologies Co., Ltd. 2023-2025. All rights reserved.
#===============================================================================

choice
    prompt "Select AIR MOUSE type"
    default SAMPLE_SUPPORT_AIR_MOUSE
    config SAMPLE_SUPPORT_AIR_MOUSE
        bool "Enable AIR MOUSE sample."
        select SYSTEM_MOUSE_PIN_CONFIG
    config SAMPLE_SUPPORT_AIR_MOUSE_DONGLE
        bool "Enable AIR MOUSE Dongle sample."
endchoice

config AIR_MOUSE_RADAR_ONLY
    bool
    default n
    depends on SAMPLE_SUPPORT_AIR_MOUSE_DONGLE
    prompt "Switch to radar only"

choice
    prompt "Select AIR MOUSE board"
    default AIR_MOUSE_HR_BOARD
    config AIR_MOUSE_SELF_BOARD
        bool "Self Board."
    config AIR_MOUSE_HR_BOARD
        bool "HR Board."
    config AIR_MOUSE_HX_BOARD
        bool "HX Board."
    config AIR_MOUSE_EVB4_BOARD
        bool "EVB4 Board."
    config AIR_MOUSE_RADAR_2T4R_BOARD
        depends on SAMPLE_SUPPORT_AIR_MOUSE_DONGLE
        bool "Radar 2T4R Dongle Board."
    config AIR_MOUSE_OPEN_SOURCE_BOARD
        bool "Open Source Board."
endchoice

choice
    prompt "Select slp usage mode"
    depends on SAMPLE_SUPPORT_AIR_MOUSE
    default SLP_USAGE_AIR_MOUSE
    config SLP_USAGE_RANGING_AOX
        bool "ranging aox."
    config SLP_USAGE_AIR_MOUSE
        bool "air mouse tv."
    config SLP_USAGE_AIR_MOUSE_CAR
        bool "air mouse car."
endchoice

config AIR_MOUSE_UAC
    bool
    default n
    prompt "Enable UAC"

config AIR_MOUSE_CI_REPLAY_TEST
    bool
    default n
    prompt "Enable ci replay test."

config SAMPLE_SUPPORT_AIR_MOUSE_OTA
    bool
    default n
    prompt "Enable OTA service."
    depends on SAMPLE_SUPPORT_AIR_MOUSE
    help
        This option means support SLE OTA service.

config SAMPLE_SUPPORT_AIR_MOUSE_CIR_PRINT
    bool
    default n
    prompt "Open CIR print."
    depends on SLP_USAGE_RANGING_AOX || SAMPLE_SUPPORT_AIR_MOUSE_DONGLE
    help
        This option means open cir print.

config SAMPLE_SUPPORT_AIR_MOUSE_DEBUG
    bool
    default n
    prompt "Open debug print."
    help
        This option means print debug log.

config LOW_POWER_MODE
    hex
    default 0
    prompt "SLE SLP Low_Power 0-Disable 1-Enable."
    depends on SAMPLE_SUPPORT_AIR_MOUSE
    help
        This option means support SLE and SLP low power mode.

config LOW_POWER_MODE
    hex
    default 0
    prompt "SLE SLP Low_Power 0-Disable 1-Enable."
    depends on SAMPLE_SUPPORT_AIR_MOUSE_DONGLE
    help
        This option means support SLE and SLP low power mode.

config SAMPLE_SUPPORT_AIR_MOUSE_SLE_ADDR_CHECK
    bool
    default n
    prompt "Check addr before sle connecting."
    depends on SAMPLE_SUPPORT_AIR_MOUSE_DONGLE
    help
        This option means check rcu address before sle connecting.

config SLE_DONGLE_SERVER_ADDR0
    hex
    default 0x0A
    prompt "Set the sle server addr[0]."
    depends on SAMPLE_SUPPORT_AIR_MOUSE_DONGLE
config SLE_DONGLE_SERVER_ADDR1
    hex
    default 0x01
    prompt "Set the sle server addr[1]."
    depends on SAMPLE_SUPPORT_AIR_MOUSE_DONGLE
config SLE_DONGLE_SERVER_ADDR2
    hex
    default 0x02
    prompt "Set the sle server addr[2]."
    depends on SAMPLE_SUPPORT_AIR_MOUSE_DONGLE
config SLE_DONGLE_SERVER_ADDR3
    hex
    default 0x03
    prompt "Set the sle server addr[3]."
    depends on SAMPLE_SUPPORT_AIR_MOUSE_DONGLE
config SLE_DONGLE_SERVER_ADDR4
    hex
    default 0x04
    prompt "Set the sle server addr[4]."
    depends on SAMPLE_SUPPORT_AIR_MOUSE_DONGLE
config SLE_DONGLE_SERVER_ADDR5
    hex
    default 0x05
    prompt "Set the sle server addr[5]."
    depends on SAMPLE_SUPPORT_AIR_MOUSE_DONGLE

config SLE_MOUSE_SERVER_ADDR0
    hex
    default 0x0A
    prompt "Set the sle server addr[0]."
    depends on SAMPLE_SUPPORT_AIR_MOUSE
config SLE_MOUSE_SERVER_ADDR1
    hex
    default 0x01
    prompt "Set the sle server addr[1]."
    depends on SAMPLE_SUPPORT_AIR_MOUSE
config SLE_MOUSE_SERVER_ADDR2
    hex
    default 0x02
    prompt "Set the sle server addr[2]."
    depends on SAMPLE_SUPPORT_AIR_MOUSE
config SLE_MOUSE_SERVER_ADDR3
    hex
    default 0x03
    prompt "Set the sle server addr[3]."
    depends on SAMPLE_SUPPORT_AIR_MOUSE
config SLE_MOUSE_SERVER_ADDR4
    hex
    default 0x04
    prompt "Set the sle server addr[4]."
    depends on SAMPLE_SUPPORT_AIR_MOUSE
config SLE_MOUSE_SERVER_ADDR5
    hex
    default 0x05
    prompt "Set the sle server addr[5]."
    depends on SAMPLE_SUPPORT_AIR_MOUSE

config AIR_MOUSE_UART_TX_PIN
    int
    range 26 26 if AIR_MOUSE_HR_BOARD
    range 26 26 if AIR_MOUSE_HX_BOARD
    range 30 30 if AIR_MOUSE_SELF_BOARD
    range 30 30 if AIR_MOUSE_EVB4_BOARD
    range 30 30 if AIR_MOUSE_RADAR_2T4R_BOARD
    range 26 26 if AIR_MOUSE_OPEN_SOURCE_BOARD
    prompt "Set the uart tx pin num."
config AIR_MOUSE_UART_RX_PIN
    int
    range 27 27 if AIR_MOUSE_HR_BOARD
    range 27 27 if AIR_MOUSE_HX_BOARD
    range 31 31 if AIR_MOUSE_SELF_BOARD
    range 31 31 if AIR_MOUSE_EVB4_BOARD
    range 31 31 if AIR_MOUSE_RADAR_2T4R_BOARD
    range 27 27 if AIR_MOUSE_OPEN_SOURCE_BOARD
    prompt "Set the uart rx pin num."
config AIR_MOUSE_UART_CTS_PIN
    int
    range 28 28 if AIR_MOUSE_HR_BOARD
    range 28 28 if AIR_MOUSE_HX_BOARD
    range 3 3 if AIR_MOUSE_SELF_BOARD
    range 3 3 if AIR_MOUSE_EVB4_BOARD
    range 3 3 if AIR_MOUSE_RADAR_2T4R_BOARD
    range 28 28 if AIR_MOUSE_OPEN_SOURCE_BOARD
    prompt "Set the uart cts pin num."
config AIR_MOUSE_UART_RTS_PIN
    int
    range 29 29 if AIR_MOUSE_HR_BOARD
    range 29 29 if AIR_MOUSE_HX_BOARD
    range 4 4 if AIR_MOUSE_SELF_BOARD
    range 4 4 if AIR_MOUSE_EVB4_BOARD
    range 4 4 if AIR_MOUSE_RADAR_2T4R_BOARD
    range 29 29 if AIR_MOUSE_OPEN_SOURCE_BOARD
    prompt "Set the uart rts pin num."
config AIR_MOUSE_POWER_ON_PIN
    int
    range 12 12 if AIR_MOUSE_HR_BOARD
    range 12 12 if AIR_MOUSE_HX_BOARD
    range 26 26 if AIR_MOUSE_SELF_BOARD
    range 26 26 if AIR_MOUSE_EVB4_BOARD
    range 26 26 if AIR_MOUSE_RADAR_2T4R_BOARD
    range 12 12 if AIR_MOUSE_OPEN_SOURCE_BOARD
    prompt "Set the slp power on pin num."
config AIR_MOUSE_POWER_CTRL_PIN
    int
    range 13 13 if AIR_MOUSE_HR_BOARD
    range 13 13 if AIR_MOUSE_HX_BOARD
    range 32 32 if AIR_MOUSE_SELF_BOARD
    range 2 2 if AIR_MOUSE_EVB4_BOARD
    range 2 2 if AIR_MOUSE_RADAR_2T4R_BOARD
    range 13 13 if AIR_MOUSE_OPEN_SOURCE_BOARD
    prompt "Set the slp power ctrl pin num."
config AIR_MOUSE_DEV_WAKEUP_HOST_PIN
    int
    range 15 15 if AIR_MOUSE_HR_BOARD
    range 15 15 if AIR_MOUSE_HX_BOARD
    range 29 29 if AIR_MOUSE_SELF_BOARD
    range 29 29 if AIR_MOUSE_EVB4_BOARD
    range 29 29 if AIR_MOUSE_RADAR_2T4R_BOARD
    range 6 6 if AIR_MOUSE_OPEN_SOURCE_BOARD
    prompt "Set the dev wakeup host pin num."
config AIR_MOUSE_SYNC_PIN
    int
    range 10 10 if AIR_MOUSE_HR_BOARD
    range 10 10 if AIR_MOUSE_HX_BOARD
    range 5 5 if AIR_MOUSE_SELF_BOARD
    range 5 5 if AIR_MOUSE_EVB4_BOARD
    range 5 5 if AIR_MOUSE_RADAR_2T4R_BOARD
    range 10 10 if AIR_MOUSE_OPEN_SOURCE_BOARD
    prompt "Set the sync pin num."
config AIR_MOUSE_IMU_INT2_PIN
    int
    range 14 14 if AIR_MOUSE_HR_BOARD
    range 14 14 if AIR_MOUSE_HX_BOARD
    range 32 32 if AIR_MOUSE_SELF_BOARD
    range 28 28 if AIR_MOUSE_EVB4_BOARD
    range 28 28 if AIR_MOUSE_RADAR_2T4R_BOARD
    range 14 14 if AIR_MOUSE_OPEN_SOURCE_BOARD
    prompt "Set the imu int2 pin num."
config ADC_USE_PIN1
    int
    prompt "Choose ADC USE pin1."
    default 30
    depends on SAMPLE_SUPPORT_AIR_MOUSE

config ADC_USE_PIN2
    int
    prompt "Choose ADC USE pin2."
    default 31
    depends on SAMPLE_SUPPORT_AIR_MOUSE

config USB_UAC_MAX_RECORD_SIZE
    hex
    prompt "Set the max recorder size of USB UAC."
    default 0x400
    help
        This option means the max recorder size of USB UAC.
    depends on SAMPLE_SUPPORT_AIR_MOUSE

config USB_PDM_TRANSFER_LEN_BY_DMA
    int
    prompt "Set the length of transfer by DMA."
    default 256
    help
        This option means the length of transfer by DMA.
    depends on SAMPLE_SUPPORT_AIR_MOUSE
```
