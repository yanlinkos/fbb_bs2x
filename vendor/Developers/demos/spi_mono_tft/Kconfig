## vendor/Developers/demos/spi_mono_tft/Kconfig
```kconfig
config SPI_MASTER_BUS_ID
    int
    prompt "Choose SPI master bus id."
    default 0

config SPI_MASTER_CLK_PIN
    int
    prompt "Choose SPI master CLK pin."
    default 9

config SPI_MASTER_CS_PIN
    int
    prompt "Choose SPI master CS pin."
    default 13

config SPI_MASTER_DI_PIN
    int
    prompt "Choose SPI master DI pin."
    default 15

config SPI_MASTER_DO_PIN
    int
    prompt "Choose SPI master DO pin."
    default 10

config SPI_MASTER_RST_PIN
    int
    prompt "Choose SPI master RST pin."
    default 11

config SPI_MASTER_DC_PIN
    int
    prompt "Choose SPI master DC pin."
    default 12
```
